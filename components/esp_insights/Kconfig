## components/esp_insights/Kconfig
```kconfig
menu "ESP Insights"

    config ESP_INSIGHTS_ENABLED
        bool "Enable ESP Insights"
        default n

    config ESP_INSIGHTS_DEBUG_ENABLED
        depends on ESP_INSIGHTS_ENABLED
        bool "Enable Insights debug prints"
        default n

endmenu
```

## components/rtc_store/Kconfig
```kconfig
menu "RTC Store"

    config RTC_STORE_DATA_SIZE
        int
        default 3072

    config RTC_STORE_CRITICAL_DATA_SIZE
        int "Size of critical data store"
        range 512 2560
        default 2048
        help
            RTC data store is allocated in RTC slow memory and with total size of 3KB.
            RTC data store is divided into two parts, critical and non-critical.
            This option configures the size of critical data buffer and remaining is used for
            non critical data buffer.
endmenu
```

## examples/diagnostics_smoke_test/main/Kconfig.projbuild
```kconfig
menu "Example Configuration"

    config ESP_WIFI_SSID
        string "WiFi SSID"
        default "myssid"
        help
            SSID (network name) for the example to connect to.

    config ESP_WIFI_PASSWORD
        string "WiFi Password"
        default "mypassword"
        help
            WiFi password (WPA or WPA2) for the example to use.

    config DIAG_ENABLE_LOG_TYPE_ALL
        bool "Enable all diagnostics log type"
        default y
        help
            By default this example enables error/warning/event diagnostics log types,
            this config option quickly disables the capture of all diagnostics log types.
endmenu
```

## unit_test_app/main/Kconfig
```kconfig
menu "ESP Insights Test App"

config APP_TEST_DATA_STORE
    bool "Enable Data Store Test"
    default y

endmenu
```
